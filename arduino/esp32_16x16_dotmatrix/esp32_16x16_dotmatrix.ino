/*
 * ESP32 + 16x16 LED 点阵屏 (MAX7219 驱动)
 * 
 * 硬件连接:
 * ESP32     MAX7219
 * GPIO 23   -> DIN (数据)
 * GPIO 18   -> CLK (时钟)
 * GPIO 5    -> CS  (片选)
 * 3.3V      -> VCC
 * GND       -> GND
 * 
 * 依赖库: LedControl by Eberhard Fahle
 * 安装：Arduino IDE -> 工具 -> 管理库 -> 搜索 "LedControl" -> 安装
 */

#include <LedControl.h>

// 引脚定义
#define DIN_PIN   23
#define CLK_PIN   18
#define CS_PIN    5

// 点阵屏数量（16x16 通常是 4 个 8x8 级联）
#define NUM_DEVICES 4

// 创建 LedControl 对象
LedControl lc = LedControl(DIN_PIN, CLK_PIN, CS_PIN, NUM_DEVICES);

// 开机延迟
#define DELAY_TIME 50

// 字模数据 (8x8 字体，16x16 需要组合)
const byte char_8x8[][8] = {
  // 0-9
  {0x00,0x00,0x3E,0x41,0x41,0x41,0x3E,0x00}, // 0
  {0x00,0x00,0x42,0x7F,0x40,0x40,0x00,0x00}, // 1
  {0x00,0x00,0x62,0x51,0x51,0x51,0x4E,0x00}, // 2
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  {0x00,0x00,0x26,0x49,0x49,0x49,0x3E,0x00}, // 9
  // A-Z
  {0x00,0x00,0x7E,0x11,0x11,0x11,0x7E,0x00}, // A
  {0x00,0x00,0x7F,0x49,0x49,0x49,0x36,0x00}, // B
  {0x00,0x00,0x3E,0x41,0x41,0x41,0x22,0x00}, // C
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  {0x00,0x00,0x7F,0x40,0x40,0x40,0x7F,0x00}, // Z
};

void setup() {
  Serial.begin(115200);
  Serial.println("ESP32 16x16 Dot Matrix Starting...");
  
  // 初始化所有设备
  for(int i = 0; i < NUM_DEVICES; i++) {
    lc.shutdown(i, false);      // 唤醒显示
    lc.setIntensity(i, 8);      // 设置亮度 (0-15)
    lc.clearDisplay(i);         // 清屏
  }
  
  Serial.println("Setup complete!");
}

void loop() {
  // 演示 1: 显示数字 0-9
  for(int i = 0; i <= 9; i++) {
    displayNumber(i);
    delay(1000);
  }
  
  // 演示 2: 显示字母 A-Z
  for(int i = 0; i <= 25; i++) {
    displayLetter(i);
    delay(500);
  }
  
  // 演示 3: 滚动文字
  scrollText("HELLO ESP32!");
  
  // 演示 4: 简单动画
  animateBox();
}

// 显示数字 (0-9)
void displayNumber(int num) {
  if(num < 0 || num > 9) return;
  
  // 16x16 显示，需要组合 4 个 8x8
  // 这里简化为左上角显示
  for(int row = 0; row < 8; row++) {
    lc.setRow(0, row, char_8x8[num][row]);
    lc.setRow(1, row, char_8x8[num][row]);
    lc.setRow(2, row, 0);
    lc.setRow(3, row, 0);
  }
}

// 显示字母 (0=A, 1=B, ...)
void displayLetter(int index) {
  if(index < 0 || index > 25) return;
  
  for(int row = 0; row < 8; row++) {
    lc.setRow(0, row, char_8x8[index + 10][row]);
    lc.setRow(1, row, char_8x8[index + 10][row]);
    lc.setRow(2, row, 0);
    lc.setRow(3, row, 0);
  }
}

// 滚动文字
void scrollText(const char* text) {
  int len = strlen(text);
  
  for(int offset = 0; offset < len * 8; offset++) {
    lc.clearDisplay(0);
    lc.clearDisplay(1);
    lc.clearDisplay(2);
    lc.clearDisplay(3);
    
    for(int i = 0; i < len; i++) {
      char c = text[i];
      int charIndex;
      
      if(c >= '0' && c <= '9') {
        charIndex = c - '0';
      } else if(c >= 'A' && c <= 'Z') {
        charIndex = c - 'A' + 10;
      } else if(c >= 'a' && c <= 'z') {
        charIndex = c - 'a' + 10;
      } else {
        continue;
      }
      
      int xPos = i * 8 - offset;
      
      // 根据位置决定显示在哪个 8x8 区域
      if(xPos >= 0 && xPos < 8) {
        for(int row = 0; row < 8; row++) {
          byte data = char_8x8[charIndex][row] >> (8 - xPos);
          if(xPos > 0) data |= char_8x8[charIndex][row] << xPos;
          lc.setRow(0, row, data);
        }
      }
    }
    
    delay(50);
  }
}

// 简单动画：移动的方块
void animateBox() {
  for(int pos = 0; pos < 16; pos++) {
    lc.clearDisplay(0);
    lc.clearDisplay(1);
    lc.clearDisplay(2);
    lc.clearDisplay(3);
    
    // 在 16x16 上画一个移动的点
    int device = pos / 8;
    int col = pos % 8;
    
    if(device < NUM_DEVICES) {
      for(int row = 0; row < 8; row++) {
        lc.setLed(device, row, col, true);
      }
    }
    
    delay(100);
  }
}
